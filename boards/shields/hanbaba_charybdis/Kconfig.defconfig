## boards/shields/hanbaba_charybdis/Kconfig.defconfig
```kconfig
if SHIELD_HANBABA_CHARYBDIS

config ZMK_KEYBOARD_NAME
    default "CharybdisTest"

endif
```

## boards/shields/hanbaba_charybdis/Kconfig.shield
```kconfig
config SHIELD_HANBABA_CHARYBDIS
    def_bool $(shields_list_contains,hanbaba_charybdis)
```
